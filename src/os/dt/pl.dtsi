/*
 * CAUTION: This file is automatically generated by Xilinx.
 * Version: HSI 
 * Today is: Wed Dec 24 14:52:20 2014
*/
 
	&amba {
		ranges ;
		axi_jtag_0: axi-jtag@43c00000 {
			compatible = "generic-uio";
			reg = <0x43c00000 0x10000>;
		};
	};


