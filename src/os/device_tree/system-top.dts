/dts-v1/;
/include/ "system-conf.dtsi"
/ {
};

&gem0 {
  #address-cells = <1>;
  phy-handle = <&phy0>;
  phy-mode = "rgmii-id";
  reg = <0xe000b000 0x1000>;
  xlnx,eth-mode = <0x1>;
  xlnx,has-mdio = <0x1>;
  xlnx,ptp-enet-clock = <108333336>;
  mdio {
    #address-cells = <1>;
    #size-cells = <0>;
    phy0: phy@1 {
      compatible = "realtek,RTL8211E";
      device_type = "ethernet-phy";
      reg = <1>;
      } ;
  } ;
};
